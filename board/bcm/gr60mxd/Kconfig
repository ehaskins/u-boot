## board/bcm/gr60mxd/Kconfig
```kconfig
if TARGET_GR60MXD

config SYS_BOARD
    default "gr60mxd"

config SYS_VENDOR
    default "bcm"

config SYS_CONFIG_NAME
    default "gr60mxd"

endif
```

## configs/gr60mxd_defconfig
```kconfig
CONFIG_TARGET_GR60MXD=y
CONFIG_ARM=y
CONFIG_ARCH_MX6=y
CONFIG_SYS_TEXT_BASE=0x17800000
CONFIG_DEFAULT_DEVICE_TREE="imx6q-gr60mxd"
CONFIG_SYS_EXTRA_OPTIONS="IMX_CONFIG=board/bcm/gr60mxd/imximage.cfg,MX6D,DDR_MB=2048"
CONFIG_SYS_CONSOLE_OVERWRITE_ROUTINE=y

CONFIG_ENV_SIZE (8 * 1024)
CONFIG_ENV_IS_IN_FAT=y
CONFIG_ENV_FAT_INTERFACE="mmc"
CONFIG_ENV_FAT_DEVICE_AND_PART="3:1"

CONFIG_SPECIFY_CONSOLE_INDEX=y
CONFIG_CONS_INDEX=2
CONFIG_DM_SERIAL=y
CONFIG_HUSH_PARSER=y

CONFIG_BOOTDELAY=1

CONFIG_BOARD_EARLY_INIT_F=y
CONFIG_MISC_INIT_R=y

CONFIG_MXC_UART=y
CONFIG_PINCTRL=y
CONFIG_PINCTRL_IMX6=y

CONFIG_DM=y
CONFIG_OF_CONTROL=y

CONFIG_DM_THERMAL=y

CONFIG_DM_GPIO=y
CONFIG_CMD_GPIO=y

CONFIG_FSL_USDHC=y
CONFIG_DM_MMC=y
CONFIG_CMD_MMC=y

CONFIG_VIDEO_IPUV3=y
CONFIG_VIDEO=y
CONFIG_CMD_BMP=y
# CONFIG_DM_VIDEO=y

CONFIG_CMD_FAT=y
CONFIG_CMD_EXT4=y
CONFIG_CMD_FS_GENERIC=y

CONFIG_CMD_BOOTZ=y

CONFIG_USB=y
CONFIG_DM_USB=y
CONFIG_USB_STORAGE=y
CONFIG_CMD_USB=y

# NXP Mfgtool support
CONFIG_CMD_FASTBOOT=y
CONFIG_USB_FUNCTION_FASTBOOT=y
CONFIG_USB_GADGET=y
CONFIG_USB_GADGET_DOWNLOAD=y
CONFIG_USB_GADGET_MANUFACTURER="FSL"
CONFIG_USB_GADGET_VENDOR_NUM=0x18D1
CONFIG_USB_GADGET_PRODUCT_NUM=0x0D02
CONFIG_CI_UDC=y
CONFIG_FSL_FASTBOOT=y
CONFIG_FASTBOOT=y
CONFIG_FASTBOOT_BUF_ADDR=0x12000000
CONFIG_FASTBOOT_BUF_SIZE=0x40000000
CONFIG_FASTBOOT_FLASH=y
CONFIG_FASTBOOT_FLASH_MMC_DEV=3
CONFIG_ANDROID_BOOT_IMAGE=y

CONFIG_PHYLIB=y
CONFIG_PHY_MICREL=y
CONFIG_PHY_MICREL_KSZ90X1=y
CONFIG_MII=y
CONFIG_CMD_DHCP=y
CONFIG_CMD_MII=y
CONFIG_CMD_PING=y
```
